//-----------------------------------------------------------------------------------------------------------------------------------------------------
//Разработчик проекта: Грабовский Александр Сергеевич - группа 1191б
//
//Цель: разработать программу для реализации двух режимов работы светодиодов
//
//Решаемые проектом задачи:
//	1. На основе константных и варьируемых бит  определять значение числа в десятичной системе счисления
//	2. Преобразовывать число из десятичной системы счисления в систему с основанием восемь
//	3. Кодировать каждую цифру числа символом для семисегментного индикатора
//	4. Выводить все цифры числа на семисегментном индикаторе, начиная со старшей цифры.
//-------------------------------------------------------------------------------------------------------------------------------------------------------------------------

#include "main.h"	//Заголовчоный файл с описанием подключаемых библиотечных модулей

//main обязательная функция для исполнегия кода пользователя
//После подачи питания или щелчка кнопкой "reset" стартует Загрузкчик, который выполняет начальную настройку основых регистров микроконтроллера 
//В завершение работы Загрузчик передаёт управление микроконтроллером функции main
int main(void){
	//Конфигурирование портов GPIO 
	RCC->AHBENR |= RCC_AHBENR_GPIOBEN;																						//Включение тактирования порта B: RCC_AHBENR_GPIOBEN=0x00040000																																			
	GPIOB->OSPEEDR |= 0x00005555;																									//установка частоты переключения выводов PB.0 – PB.7 на уровне 10 МГц
	GPIOB->MODER |= GPIO_MODER_MODER0_0 | GPIO_MODER_MODER1_0 										//Переключение линий 0-8 порта B в режим "Output"
								| GPIO_MODER_MODER2_0 | GPIO_MODER_MODER7_0 
								| GPIO_MODER_MODER6_0 | GPIO_MODER_MODER5_0 
								| GPIO_MODER_MODER4_0	|  GPIO_MODER_MODER3_0 
								| GPIO_MODER_MODER8_0;
	GPIOB->MODER&=~( GPIO_MODER_MODER12 | GPIO_MODER_MODER13 |										//Переключаем линий 12(SW4),13(SW3),14(SW2),15(SW1)порта B в режим "Input"
									 GPIO_MODER_MODER14 | GPIO_MODER_MODER15);		
	
	unsigned  reg[8] = {0x101, 0x102, 0x104, 0x180, 0x140, 0x120, 0x110, 0x108};  //Регистры для запуска светодиодов
	uint32_t n;																																		//Степень коэффицента базовой задержки: K=2^n
	//Реализация процесса зажигания светодиодов
	while(1){
		n=((GPIOB->IDR)&0x3000)>>12;																								//Определение степени коэффицента базовой задержки
		//Прямой режим работы светодиодов
		if( ((GPIOB->IDR)&0x4000)>>14 == 1){
			//Режим последовательного запуска
			if( ((GPIOB->IDR)&0x8000)>>15 == 1){
				//Последовательно загораются светодиоды
				for (uint32_t i = 0; i<8; i++){
					GPIOB->ODR |= reg[i];																									//Зажигание светодиодов
					delay((uint32_t)50000<<n);																						//Задержка после включения светодиода
				}
				//Последовательно гаснут светодиоды
				for (uint32_t j = 0; j<8; j++){
					GPIOB->ODR &=~ reg[j];																								//Выключение светодиода																			
					delay((uint32_t)50000<<n);																						//Задержка после выключения светодиода
				}
			}
			//Режим "бегущего" огонька  
			else{
				for (uint32_t i = 0; i<8; i++){
					GPIOB->ODR |= reg[i];																									//Зажигание светодиодов
					delay((uint32_t)50000<<n);																						//Задержка после включения светодиода
					GPIOB->ODR &=~ reg[i];																								//Выключение светодиода		
				}	
			}
		}
		//Реверсный режим работы светодиодов
		else{
			//Режим последовательного запуска
			if( ((GPIOB->IDR)&0x8000)>>15 == 1){
				//Последовательно загораются светодиоды
				for (int i = 7; i>=0; i--){
					GPIOB->ODR |= reg[i];																									//Зажигание светодиодов
					delay((uint32_t)50000<<n);																						//Задержка после включения светодиода
				}
				//Последовательно гаснут светодиоды
				for (int j = 7; j>=0; j--){
					GPIOB->ODR &=~ reg[j];																								//Выключение светодиода		
					delay((uint32_t)50000<<n);																						//Задержка после выключения светодиода
				}
			}
			//Режим "бегущего" огонька  
			else{
				for (int i = 7; i>=0; i--){
					GPIOB->ODR |= reg[i];																									//Зажигание светодиодов
					delay((uint32_t)50000<<n);																						//Задержка после включения светодиода
					GPIOB->ODR &=~ reg[i];																								//Выключение светодиода		
				}	
			}			
		}	
	}	
}
//функция задержки: count - количество элементарных периодов задержки с длительностью примерно 2,5 мкс
void delay(uint32_t count)
{
	volatile uint32_t i;																													//объявляем неоптимизируемую переменную
	for (i =0;i<count;i++);																												//выполнение пустых циклов для реализации програмной задержки	
}
//----------------------------------------------------------------------------------------------------------------------------------------------
//Руководство пользователя:
//	1. Для запуска загруженной программы удалите перемычку "boot" на стенде и нажмите "reset" 
//  2. Выбор режима работы реализуется микропереключателем SW1
//	3. Реверсный режим работы реализуется микропереключателем SW2
//	4. Для управления задержкой используются микропереключатели SW3(старший разряд) и SW4 (младший разряд)	
//----------------------------------------------------------------------------------------------------------------------------------------------
