//-----------------------------------------------------------------------------------------------------------------------------
//	Проект: "TimerBlink".
//	Разработчик проекта: Грабовский Александр Сергеевич - группа 1192б
//	Цель: изучить применение ШИМ в среде Keil uVision на основе базовых таймеров микроконтроллера STM32F072RBTx на стенде STM_01
//	Решеные проектом задачи:
//			1.	Продемонстрировать назначение основных регистров для программирования базовых таймеров на основе CMSIS
//			2.	Выполнить настройку обработчика прерываний базовых таймеров TIM6 и TIM7
//			3.	Разработать программу управления волнообразной (обратная наклонная) яркостью мигания светодиода посредством таймера TIM6
//			4.	Разработать проргамму упарвления длительностью мигания светодиода посредством таймера TIM7
//-----------------------------------------------------------------------------------------------------------------------------

#include "main.h"																																																//																																						//	Константа для работы с мегагерцами и микросекундами
static uint32_t tim7Time[4] = {3,4,6,12};																																				//	Массив с длительностями фаз, где 3003 = mhz / (333 * 1), 1001 = mhz / (333 * 3), и далле для 5 и 7
static uint32_t phase = 0;																																											//	Номер текущей фазы уровней яркости светодиода
static _Bool statePB0 = 0; 																																											//	Текущее состояние на выводе PB.0: 0 - светодиод погашен; 1 - светодиод горит
static uint32_t T ;
static _Bool statePB15_14;

																																																								//
int main()																																																			//	Основная программа микроконтроллера
{																																																								//
	__disable_irq();																																															//	Глобальное запрещение прерываний
	InitPortB();																																																	//	Инициализация порта B
	InitTimer();																																																	//	Инициализация таймера TIM6
	NVIC->ISER[0] |= 0x60000;																																											//	Разрешение в NVIC прерывания от модуля TIM6 (17 линия)
	__enable_irq();																																																//	Глобальное разрешение прерываний
	TIM7->CR1 |= 0x1;																																															//	Разрешение работы таймера
	TIM6->CR1 |= 0x1;																																															//
	while (1);																																																		//	Пустой цикл основной программы
}																																																								//
																																																								//
void InitPortB(void)																																														//	Функция инициализации порта B с подключенным светодиодом VD0 и микропереключателями SW3 и SW4
{																																																								//
	RCC->AHBENR|=RCC_AHBENR_GPIOBEN;																																							//	Включение тактирования порта B: RCC_AHBENR_GPIOBEN=0x00040000
	GPIOB->MODER|=GPIO_MODER_MODER0_0 | GPIO_MODER_MODER8_0;																											//	Переключение линий 0 и 8 в режим "Output": GPIO_MODER_MODER0_0 = 0x1; GPIO_MODER_MODER8_0 = 0x10000
	GPIOB->MODER&=~(GPIO_MODER_MODER12 																																						//
								| GPIO_MODER_MODER13 																																						//
							  | GPIO_MODER_MODER14																																						//
								| GPIO_MODER_MODER15);																																					//	Переключение линий 12 (SW4), 13 (SW3), 14 (SW2) и 15 (SW1) порта B в режим "Input"
	GPIOB->BSRR=0x100;																																														//	Разрешение работы светодиодов на стенде STM_01 с помощью установки логической "1" на выводе PB.8
	statePB15_14=((GPIOB->IDR)&0xc000)>>14;
	T = (4000 + 1000 * (((GPIOB->IDR)&0xc000)>>14));
}																																																								//
																																																								//
void InitTimer(void)																																														//	Функция инициализации базовых таймеров TIM6 и TIM7
{																																																								//	
	RCC->APB1ENR|=RCC_APB1ENR_TIM6EN|RCC_APB1ENR_TIM7EN;																													//
	TIM6->PSC=7;																													  																			//	Установка коэффициента предделителя равного 8000: после предделителя частота сигнала = Частота на шине AP8 / 8000 = 8 МГц / 8000 = 1 кГц
	TIM7->PSC=852;																													  																		//	Установка коэффициента предделителя равного 8000: после предделителя частота сигнала = Частота на шине AP8 / 8000 = 8 МГц / 8000 = 1 кГц
	TIM7->ARR=tim7Time[(((GPIOB->IDR)&0x3000)>>12)];																															//	Длительность периода обновления таймера = half_period / 1 кГц = 125 / 1000 = 0.125 секунды при инициализации таймера
	TIM6->ARR=(uint32_t)(T);																																											//	Длительность периода обновления таймера = half_period / 1 кГц = 125 / 1000 = 0.125 секунды при инициализации таймера
	TIM6->DIER|=0x1;																																															//	Разрешить аппаратную уставноку сигнала прерывания при событии обновления таймера (UEV)
	TIM7->DIER|=0x1;																																															//	Разрешить аппаратную уставноку сигнала прерывания при событии обновления таймера (UEV)
}																																																								//
																																																								//
void TIM7_IRQHandler(void)																																											//	Функция-обработчик прерывания таймера TIM7
{																																																								//                                           
	TIM7->ARR = tim7Time[(((GPIOB->IDR)&0x3000)>>12)];	              																						//  Установка частоты мигания светодиода считывая положение переключателей SW3 и SW4
	phase++;																																																			//	Прибавление номера фазы для отображения волны формы обрантная наклонная
	if (phase==390)																																																//	Сброс номера фазы в 0, если она достигла значения 333
		phase=0;																																																		//
	TIM7->SR=0;																																																		//	Сбросить флаг прерывания таймера TIM7
}																																																								//
																																																								//
void TIM6_DAC_IRQHandler(void)																																									//	Функция-обработчик прерывания таймера TIM6
{																																																								//  Установка длительности периода обновления таймера в соответсвии с SW1 и  SW2
	if(statePB15_14!=((GPIOB->IDR)&0xc000)>>14)
	{
		statePB15_14=((GPIOB->IDR)&0xc000)>>14;
		T=(4000 + 1000 * (((GPIOB->IDR)&0xc000)>>14));
	}
	if (statePB0==0)                                                        																			//  Если светодиод выключен,
		TIM6->ARR =(uint32_t)(T*0.01 + ((T*0.94)/390)*(phase+1));																										//  Подача на диод частоты 
	else                                                																													//  Если светодиод включен
		TIM6->ARR =(uint32_t)(T*0.95 - ((T*0.94)/390)*(phase+1));	  																								//  																																																							//	
	statePB0 = !statePB0;																																													//	Инвертировать состояние светодиода PB.0
	GPIOB->BRR = 0x1;																																															//	Отключить светодиод на выводе PB.0 
	GPIOB->BSRR = statePB0;																																												//	Уставновить светодиод на выводе PB.0 в соответствии с состоянием, хранимым в переменноой statePB0
	TIM6->SR=0;																																																		//	Сбросить флаг прерывания таймера TIM6
}

//-----------------------------------------------------------------------------------------------------------------------------
//	Руководство пользователя:
//		1.	Для запуска загруженной программы удалите перемычку "boot" на стенде и нажмите кнопку "reset"
//		2.	В управлении частотой мигания светодиода используйте микропереключатели SW3, SW4
//		3.	В управлении частоты ШИМ используйте микропереключатели SW1, SW2
//-----------------------------------------------------------------------------------------------------------------------------
